## conf/machine/compulab-imx8mp.conf
```bitbake
SUPER_EVK = "1"
SUPER_IOT = "1"

require ucm-imx8m-plus.conf

WKS_BOOT_SIZE = "256M"
```

## conf/machine/include/compulab-imx8mp-groups.inc
```bitbake
SUPER_EVK ??= "0"
SUPER_IOT ??= "0"

MACHINEOVERRIDES .= "${@':compulab-family-groups' if d.getVar('SUPER_EVK') == '1' or d.getVar('SUPER_IOT') == '1' else ''}"
MACHINEOVERRIDES .= "${@':compulab-evk-group' if d.getVar('SUPER_EVK') == '1' else ''}"
MACHINEOVERRIDES .= "${@':compulab-iot-group' if d.getVar('SUPER_IOT') == '1' else ''}"

WKS_FILE:compulab-family-groups = "compulab-imx8mp-groups.wks.in"
WKS_BOOT_SIZE:compulab-family-groups = "256M"

require machine-payload/iot-gate-imx8plus.inc
require machine-payload/iotdin-imx8p.inc
require machine-payload/mcm-imx8m-plus.inc
require machine-payload/som-imx8m-plus.inc
require machine-payload/ucm-imx8m-plus.inc
require machine-payload/ucm-imx8m-plus-sbev.inc

COMPULAB_IMX8MP_EVK_MACHINES = " \
	mcm-imx8m-plus \
	som-imx8m-plus \
	ucm-imx8m-plus \
	ucm-imx8m-plus-sbev \
"

COMPULAB_IMX8MP_IOT_MACHINES = " \
	iot-gate-imx8plus \
	iotdin-imx8p \
"

COMPULAB_IMX8MP_EVK_DEVICETREES = " \
	${COMPULAB_MCM_IMX8M_PLUS_DEVICETREES} \
	${COMPULAB_SOM_IMX8M_PLUS_DEVICETREES} \
	${COMPULAB_UCM_IMX8M_PLUS_DEVICETREES} \
	${COMPULAB_UCM_IMX8M_PLUS_SBEV_DEVICETREES} \
"

COMPULAB_IMX8MP_IOT_DEVICETREES = " \
	${COMPULAB_IOT_GATE_IMX8PLUS_DEVICETREES} \
	${COMPULAB_IOTDIN_IMX8P_DEVICETREES} \
"

COMPULAB_IMX8MP_EVK_CORE_IMAGE_EXTRA_INSTALL = " \
	${COMPULAB_SOM_IMX8M_PLUS_CORE_IMAGE_EXTRA_INSTALL} \
"

COMPULAB_IMX8MP_IOT_IMAGE_INSTALL = " \
	${COMPULAB_IOT_GATE_IMX8PLUS_IMAGE_INSTALL} \
	${COMPULAB_IOTDIN_IMX8P_IMAGE_INSTALL} \
"

COMPULAB_IMX8MP_IOT_CORE_IMAGE_EXTRA_INSTALL = " \
	${COMPULAB_IOT_GATE_IMX8PLUS_CORE_IMAGE_EXTRA_INSTALL} \
	${COMPULAB_IOTDIN_IMX8P_CORE_IMAGE_EXTRA_INSTALL} \
"

COMPULAB_IMX8MP_EVK_MACHINE_FEATURES = " \
	${COMPULAB_MCM_IMX8M_PLUS_MACHINE_FEATURES} \
	${COMPULAB_SOM_IMX8M_PLUS_MACHINE_FEATURES} \
"

COMPULAB_IMX8MP_EVK_MACHINE_FIRMWARE = " \
	${COMPULAB_MCM_IMX8M_PLUS_MACHINE_FIRMWARE} \
"

COMPULAB_IMX8MP_EVK_KERNEL_MODULE_AUTOLOAD = " \
	${COMPULAB_UCM_IMX8M_PLUS_KERNEL_MODULE_AUTOLOAD} \
"

KERNEL_DEVICETREE:append:compulab-evk-group = " \
	${COMPULAB_IMX8MP_EVK_DEVICETREES} \
"

KERNEL_DEVICETREE:append:compulab-iot-group = " \
	${COMPULAB_IMX8MP_IOT_DEVICETREES} \
"

IMAGE_INSTALL:append:compulab-iot-group = " \
	${COMPULAB_IMX8MP_IOT_IMAGE_INSTALL} \
"

CORE_IMAGE_EXTRA_INSTALL:append:compulab-evk-group = " \
	${COMPULAB_IMX8MP_EVK_CORE_IMAGE_EXTRA_INSTALL} \
"

CORE_IMAGE_EXTRA_INSTALL:append:compulab-iot-group = " \
	${COMPULAB_IMX8MP_IOT_CORE_IMAGE_EXTRA_INSTALL} \
"

CORE_IMAGE_EXTRA_INSTALL:append:compulab-family-groups = " \
	${@'u-boot-compulab-multi' if d.getVar('COMPULAB_UBOOT_MULTI_CONFIGS') else ''} \
"

MACHINE_FEATURES:append:compulab-evk-group = " \
	${COMPULAB_IMX8MP_EVK_MACHINE_FEATURES} \
"

MACHINE_FIRMWARE:append:compulab-evk-group = " \
	${COMPULAB_IMX8MP_EVK_MACHINE_FIRMWARE} \
"

KERNEL_MODULE_AUTOLOAD:append:compulab-evk-group = " \
	${COMPULAB_IMX8MP_EVK_KERNEL_MODULE_AUTOLOAD} \
"
```

## conf/machine/include/device-tree/iot-gate-imx8plus.inc
```bitbake
KERNEL_DEVICETREE += " 	compulab/iot-gate-imx8plus.dtb 	compulab/iot-gate-imx8plus-usbdev.dtb 	compulab/iot-gate-imx8plus-m2tpm.dtb "
```

## conf/machine/include/device-tree/mcm-imx8m-plus.inc
```bitbake
KERNEL_DEVICETREE += " 	compulab/mcm-imx8m-plus-som.dtb 	compulab/mcm-imx8m-plus.dtb 	compulab/mcm-imx8m-plus-evk-audio.dtb 	compulab/mcm-imx8m-plus-evk-eth.dtb 	compulab/mcm-imx8m-plus-headless.dtb 	compulab/mcm-imx8m-plus-thermal.dtb 	compulab/mcm-imx8m-plus-mipi.dtb 	compulab/mcm-imx8m-plus-lvds.dtb 	compulab/mcm-imx8m-plus-hdmi.dtb 	compulab/mcm-imx8m-plus_mipi-csi1-ar1335-af.dtb 	compulab/mcm-imx8m-plus_mipi-csi2-ar1335-af.dtb 	compulab/mcm-imx8m-plus_mipi-csi1-ar1335-mcu.dtb 	compulab/mcm-imx8m-plus_mipi-csi2-ar1335-mcu.dtb  	compulab/mcm-imx8m-plus-eb-eth.dtbo 	compulab/mcm-imx8m-plus-eb-audimx9.dtbo 	compulab/mcm-imx8m-plus-pcie.dtbo 	compulab/mcm-imx8m-plus-mipi.dtbo 	compulab/mcm-imx8m-plus-lvds.dtbo 	compulab/mcm-imx8m-plus-hdmi.dtbo 	compulab/mcm-imx8m-plus-usbdev.dtbo 	compulab/mcm-imx8m-plus-rpmsg.dtbo 	compulab/mcm-imx8m-plus-ldo4.dtbo 	compulab/mcm-imx8m-plus-spidev.dtbo 	compulab/mcm-imx8m-plus-sd8997.dtbo 	compulab/mcm-imx8m-plus-mmc2.dtbo 	compulab/mcm-imx8m-plus-thermal.dtbo 	compulab/mcm-imx8m-plus-uart1.dtbo 	compulab/mcm-imx8m-plus-uart3.dtbo 	compulab/mcm-imx8m-plus-uart4.dtbo 	compulab/mcm-imx8m-plus_mipi-csi1-ar1335-af.dtbo 	compulab/mcm-imx8m-plus_mipi-csi2-ar1335-af.dtbo 	compulab/mcm-imx8m-plus_mipi-csi1-ar1335-mcu.dtbo 	compulab/mcm-imx8m-plus_mipi-csi2-ar1335-mcu.dtbo 	compulab/mcm-imx8m-plus_mipi-csi1-imx219.dtbo "
```

## conf/machine/include/device-tree/som-imx8m-plus.inc
```bitbake
KERNEL_DEVICETREE += " \
    compulab/som-imx8m-plus.dtb \
    compulab/som-imx8m-plus-hdmi.dtb \
    compulab/som-imx8m-plus-headless.dtb \
    compulab/som-imx8m-plus-lvds.dtb \
    compulab/som-imx8m-plus_mipi-csi1-ar0234.dtb \
    compulab/som-imx8m-plus_mipi-csi1-ar0521.dtb \
    compulab/som-imx8m-plus_mipi-csi1-ar1335-af.dtb \
    compulab/som-imx8m-plus_mipi-csi1-ar1335-mcu.dtb \
    compulab/som-imx8m-plus_mipi-csi1-csi2.dtb \
    compulab/som-imx8m-plus_mipi-csi1-imx219.dtb \
    compulab/som-imx8m-plus_mipi-csi1-ov5647.dtb \
    compulab/som-imx8m-plus_mipi-csi2-ar0234.dtb \
    compulab/som-imx8m-plus_mipi-csi2-ar0521.dtb \
    compulab/som-imx8m-plus_mipi-csi2-ar1335-af.dtb \
    compulab/som-imx8m-plus_mipi-csi2-ar1335-mcu.dtb \
    compulab/som-imx8m-plus_mipi-csi2-imx219.dtb \
    compulab/som-imx8m-plus_mipi-csi2-ov5647.dtb \
    compulab/som-imx8m-plus-mipi.dtb \
    compulab/som-imx8m-plus-rpmsg.dtb \
    compulab/som-imx8m-plus-thermal.dtb \
    compulab/som-imx8m-plus-usbdev.dtb \
    compulab/som-imx8m-plus-hdmi.dtbo \
    compulab/som-imx8m-plus-lvds.dtbo \
    compulab/som-imx8m-plus_mipi-csi1-ar0234.dtbo \
    compulab/som-imx8m-plus_mipi-csi1-ar0521.dtbo \
    compulab/som-imx8m-plus_mipi-csi1-ar1335-af.dtbo \
    compulab/som-imx8m-plus_mipi-csi1-ar1335-mcu.dtbo \
    compulab/som-imx8m-plus_mipi-csi1-imx219.dtbo \
    compulab/som-imx8m-plus_mipi-csi1-ov5647.dtbo \
    compulab/som-imx8m-plus_mipi-csi2-ar0234.dtbo \
    compulab/som-imx8m-plus_mipi-csi2-ar0521.dtbo \
    compulab/som-imx8m-plus_mipi-csi2-ar1335-af.dtbo \
    compulab/som-imx8m-plus_mipi-csi2-ar1335-mcu.dtbo \
    compulab/som-imx8m-plus_mipi-csi2-imx219.dtbo \
    compulab/som-imx8m-plus_mipi-csi2-ov5647.dtbo \
    compulab/som-imx8m-plus-mipi.dtbo \
    compulab/som-imx8m-plus-thermal.dtbo \
    compulab/som-imx8m-plus-usbdev.dtbo \
    compulab/compulab-imx8m-plus-rpmsg.dtbo \
"
```

## conf/machine/include/device-tree/ucm-imx8m-plus.inc
```bitbake
KERNEL_DEVICETREE += " \
    compulab/ucm-imx8m-plus-headless.dtb \
    compulab/ucm-imx8m-plus.dtb \
    compulab/ucm-imx8m-plus-mipi.dtb \
    compulab/ucm-imx8m-plus-hdmi.dtb \
    compulab/ucm-imx8m-plus-lvds.dtb \
    compulab/ucm-imx8m-plus_mipi-csi1-ar1335-af.dtb \
    compulab/ucm-imx8m-plus_mipi-csi1-ar1335-mcu.dtb \
    compulab/ucm-imx8m-plus_mipi-csi1-imx219.dtb \
    compulab/ucm-imx8m-plus_mipi-csi1-ov5647.dtb \
    compulab/ucm-imx8m-plus_mipi-csi2-ar1335-af.dtb \
    compulab/ucm-imx8m-plus-rpmsg.dtb \
    compulab/ucm-imx8m-plus-usbdev.dtb \
    compulab/ucm-imx8m-plus-wm8731.dtb \
    compulab/ucm-imx8m-plus-thermal.dtb \
    compulab/ucm-imx8m-plus-ldo4.dtb \
    compulab/ucm-imx8m-plus-mipi.dtbo \
    compulab/ucm-imx8m-plus-hdmi.dtbo \
    compulab/ucm-imx8m-plus-lvds.dtbo \
    compulab/ucm-imx8m-plus-rtc.dtbo \
    compulab/ucm-imx8m-plus-wm8731.dtbo \
    compulab/ucm-imx8m-plus-thermal.dtbo \
    compulab/ucm-imx8m-plus_mipi-csi1-ar1335-af.dtbo \
    compulab/ucm-imx8m-plus_mipi-csi1-ar1335-mcu.dtbo \
    compulab/ucm-imx8m-plus_mipi-csi1-imx219.dtbo \
    compulab/ucm-imx8m-plus_mipi-csi1-ov5647.dtbo \
    compulab/ucm-imx8m-plus_mipi-csi2-ar1335-af.dtbo \
    compulab/compulab-imx8m-plus-rpmsg.dtbo \
"
```

## conf/machine/include/machine-payload/iot-gate-imx8plus.inc
```bitbake
COMPULAB_IOT_GATE_IMX8PLUS_DEVICETREES = " \
	compulab/iot-gate-imx8plus.dtb \
	compulab/iot-gate-imx8plus-usbdev.dtb \
	compulab/iot-gate-imx8plus-m2tpm.dtb \
"

COMPULAB_IOT_GATE_IMX8PLUS_IMAGE_INSTALL = " \
	iot-gate-imx8plus-config \
"

COMPULAB_IOT_GATE_IMX8PLUS_CORE_IMAGE_EXTRA_INSTALL = " \
	gpsd gps-utils ppp modemmanager \
"
```

## conf/machine/include/machine-payload/iot-gate-imx8pv2.inc
```bitbake
COMPULAB_IOT_GATE_IMX8PV2_DEVICETREES = " \
    compulab/iot-gate-imx8pv2.dtb \
    compulab/iot-gate-imx8pv2-headless.dtb \
    compulab/iotg-imx8pv2-can-a.dtbo \
    compulab/iotg-imx8pv2-can-b.dtbo \
    compulab/iotg-imx8pv2-cmd-button.dtbo \
    compulab/iotg-imx8pv2-do0.dtbo \
    compulab/iotg-imx8pv2-do1.dtbo \
    compulab/iotg-imx8pv2-do2.dtbo \
    compulab/iotg-imx8pv2-do3.dtbo \
    compulab/iotg-imx8pv2-hdmi.dtbo \
    compulab/iotg-imx8pv2-modem.dtbo \
    compulab/iotg-imx8pv2-nvme.dtbo \
    compulab/iotg-imx8pv2-rs485-a.dtbo \
    compulab/iotg-imx8pv2-rs485-b.dtbo \
    compulab/iotg-imx8pv2-wifi.dtbo \
    compulab/iotg-imx8pv2-wifi-sdio.dtbo \
"

COMPULAB_IOT_GATE_IMX8PV2_IMAGE_INSTALL = " \
    iot-gate-imx8pv2-config \
"

COMPULAB_IOT_GATE_IMX8PV2_CORE_IMAGE_EXTRA_INSTALL = " \
    gpsd gps-utils ppp modemmanager \
"
```

## conf/machine/include/machine-payload/iotdin-imx8p.inc
```bitbake
COMPULAB_IOTDIN_IMX8P_DEVICETREES = " \
	compulab/iotdin-imx8p.dtb \
"

COMPULAB_IOTDIN_IMX8P_IMAGE_INSTALL = " \
	iotd-imx8p-config nvme-cli fio smartmontools \
"

COMPULAB_IOTDIN_IMX8P_CORE_IMAGE_EXTRA_INSTALL = " \
	gpsd gps-utils ppp modemmanager \
"
```

## conf/machine/include/machine-payload/mcm-imx8m-plus.inc
```bitbake
COMPULAB_MCM_IMX8M_PLUS_DEVICETREES = " \
	compulab/mcm-imx8m-plus-som.dtb \
	compulab/mcm-imx8m-plus.dtb \
	compulab/mcm-imx8m-plus-evk-audio.dtb \
	compulab/mcm-imx8m-plus-evk-eth.dtb \
	compulab/mcm-imx8m-plus-headless.dtb \
	compulab/mcm-imx8m-plus-thermal.dtb \
	compulab/mcm-imx8m-plus-mipi.dtb \
	compulab/mcm-imx8m-plus-lvds.dtb \
	compulab/mcm-imx8m-plus-hdmi.dtb \
	compulab/mcm-imx8m-plus_mipi-csi1-ar1335-af.dtb \
	compulab/mcm-imx8m-plus_mipi-csi2-ar1335-af.dtb \
	compulab/mcm-imx8m-plus_mipi-csi1-ar1335-mcu.dtb \
	compulab/mcm-imx8m-plus_mipi-csi2-ar1335-mcu.dtb \
	compulab/mcm-imx8m-plus-eb-eth.dtbo \
	compulab/mcm-imx8m-plus-eb-audimx9.dtbo \
	compulab/mcm-imx8m-plus-pcie.dtbo \
	compulab/mcm-imx8m-plus-mipi.dtbo \
	compulab/mcm-imx8m-plus-lvds.dtbo \
	compulab/mcm-imx8m-plus-hdmi.dtbo \
	compulab/mcm-imx8m-plus-usbdev.dtbo \
	compulab/mcm-imx8m-plus-rpmsg.dtbo \
	compulab/mcm-imx8m-plus-ldo4.dtbo \
	compulab/mcm-imx8m-plus-spidev.dtbo \
	compulab/mcm-imx8m-plus-sd8997.dtbo \
	compulab/mcm-imx8m-plus-mmc2.dtbo \
	compulab/mcm-imx8m-plus-thermal.dtbo \
	compulab/mcm-imx8m-plus-uart1.dtbo \
	compulab/mcm-imx8m-plus-uart3.dtbo \
	compulab/mcm-imx8m-plus-uart4.dtbo \
	compulab/mcm-imx8m-plus_mipi-csi1-ar1335-af.dtbo \
	compulab/mcm-imx8m-plus_mipi-csi2-ar1335-af.dtbo \
	compulab/mcm-imx8m-plus_mipi-csi1-ar1335-mcu.dtbo \
	compulab/mcm-imx8m-plus_mipi-csi2-ar1335-mcu.dtbo \
"

COMPULAB_MCM_IMX8M_PLUS_MACHINE_FEATURES = "mrvl8997"

# The common CompuLab configuration installs imx-firmware-mrvl, including the
# SD8997 combo firmware and its sd8997_uapsta/sdsd8997 aliases. Do not install
# linux-firmware-sd8997 as it owns the same paths with different contents.
COMPULAB_MCM_IMX8M_PLUS_MACHINE_FIRMWARE = " \
	linux-firmware-iwlwifi-misc \
"
```

## conf/machine/include/machine-payload/mcm-imx8pv2.inc
```bitbake
COMPULAB_MCM_IMX8PV2_DEVICETREES = " \
    compulab/mcm-imx8pv2.dtb \
    compulab/mcm-imx8pv2-som.dtb \
    compulab/mcm-imx8pv2-base.dtb \
    compulab/sbc-mcm8pv2-headless.dtb \
    compulab/sbc-mcm8pv2-hdmi.dtb \
    compulab/sbc-mcm8pv2-lvds.dtb \
    compulab/sbc-mcm8pv2-mipi.dtb \
    compulab/sbc-mcm8pv2-allheads.dtb \
    compulab/sbc-mcm8pv2.dtbo \
    compulab/sbc-mcm8pv2-usbdev.dtbo \
    compulab/sbc-mcm8pv2-pcie.dtbo \
    compulab/sbc-mcm8pv2-enet.dtbo \
    compulab/sbc-mcm8pv2-enet1.dtbo \
    compulab/sbc-mcm8pv2-lvds.dtbo \
    compulab/sbc-mcm8pv2-mipi.dtbo \
    compulab/sbc-mcm8pv2-hdmi.dtbo \
    compulab/sbc-mcm8pv2-wm8962.dtbo \
    compulab/sbc-mcm8pv2-p17_can.dtbo \
    compulab/sbc-mcm8pv2-p19_uart-b.dtbo \
    compulab/sbc-mcm8pv2-p20_uart-a.dtbo \
    compulab/sbc-mcm8pv2-p15_spi.dtbo \
    compulab/sbc-mcm8pv2-p16_spi.dtbo \
    compulab/sbc-mcm8pv2-p16_i2c.dtbo \
    compulab/sbc-mcm8pv2-p18_gpio.dtbo \
"
```

## conf/machine/include/machine-payload/ucm-imx8m-plus-sbev.inc
```bitbake
COMPULAB_UCM_IMX8M_PLUS_SBEV_DEVICETREES = " \
	compulab/ucm-imx8m-plus-sbev.dtb \
	compulab/ucm-imx8m-plus-som.dtb \
	compulab/sbev-ucmimx8plus.dtb \
	compulab/sbev-ucmimx8plus-dualhead.dtb \
	compulab/sbev-ucmimx8plus-hdmi.dtb \
	compulab/sbev-ucmimx8plus-headless.dtb \
	compulab/sbev-ucmimx8plus.dtbo \
	compulab/sbev-ucmimx8plus-cma.dtbo \
	compulab/sbev-ucmimx8plus-enet1.dtbo \
	compulab/sbev-ucmimx8plus-leds.dtbo \
	compulab/sbev-ucmimx8plus-lvds.dtbo \
	compulab/sbev-ucmimx8plus-hdmi.dtbo \
	compulab/sbev-ucmimx8plus-mmc2.dtbo \
	compulab/sbev-ucmimx8plus-p15_spi.dtbo \
	compulab/sbev-ucmimx8plus-p16_i2c.dtbo \
	compulab/sbev-ucmimx8plus-p17_can.dtbo \
	compulab/sbev-ucmimx8plus-p18_gpio.dtbo \
	compulab/sbev-ucmimx8plus-p19_uart-b.dtbo \
	compulab/sbev-ucmimx8plus-p20_uart-a.dtbo \
	compulab/sbev-ucmimx8plus-wm8962.dtbo \
	compulab/sbev-ucmimx8plus-csi1-isp0.dtbo \
	compulab/sbev-ucmimx8plus-csi1-isi0.dtbo \
	compulab/sbev-ucmimx8plus-csi2-isp1.dtbo \
	compulab/sbev-ucmimx8plus-csi2-isi1.dtbo \
	compulab/sbev-ucmimx8plus-csi1-isp0-ov5647.dtbo \
	compulab/sbev-ucmimx8plus-csi1-isp0-imx219.dtbo \
	compulab/sbev-ucmimx8plus-csi2-isp1-ov5647.dtbo \
	compulab/sbev-ucmimx8plus-csi2-isp1-imx219.dtbo \
	compulab/sbev-ucmimx8plus-csi1-isi0-ecam0521.dtbo \
	compulab/sbev-ucmimx8plus-csi1-isi0-ecam131.dtbo \
	compulab/sbev-ucmimx8plus-csi2-isi1-ecam0521.dtbo \
	compulab/sbev-ucmimx8plus-csi2-isi1-ecam131.dtbo \
	compulab/ucm-imx8m-plus-usbdev.dtbo \
"
```

## conf/machine/iot-gate-imx8plus.conf
```bitbake
#@TYPE: Machine
#@NAME: CompuLab IOT-GATE-IMX8PLUS - Industrial IoT Gateway
#@SOC: i.MX8MM
#@DESCRIPTION: Machine configuration for IOT-GATE-IMX8PLUS
#@MAINTAINER: compulab@compulab.co.il

require compulab-imx8mp.inc

KERNEL_DEVICETREE = "${COMPULAB_IOT_GATE_IMX8PLUS_DEVICETREES}"

# Set u-boot DTB
UBOOT_DTB_NAME = "iot-gate-imx8plus.dtb"

IMAGE_INSTALL:append = " ${COMPULAB_IOT_GATE_IMX8PLUS_IMAGE_INSTALL} "

CORE_IMAGE_EXTRA_INSTALL += " ${COMPULAB_IOT_GATE_IMX8PLUS_CORE_IMAGE_EXTRA_INSTALL} "
```

## conf/machine/iot-gate-imx8pv2.conf
```bitbake
#@TYPE: Machine
#@NAME: CompuLab IOT-GATE-IMX8PV2 - Industrial IoT Gateway
#@SOC: i.MX8MP
#@DESCRIPTION: Machine configuration for IOT-GATE-IMX8PV2
#@MAINTAINER: compulab@compulab.co.il

require compulab-imx8mp.inc

KERNEL_DEVICETREE = "${COMPULAB_IOT_GATE_IMX8PV2_DEVICETREES}"
#
# Set u-boot DTB
UBOOT_DTB_NAME = "iot-gate-imx8pv2.dtb"

# IMAGE_INSTALL:append = " ${COMPULAB_IOT_GATE_IMX8PV2_IMAGE_INSTALL} "

CORE_IMAGE_EXTRA_INSTALL += " ${COMPULAB_IOT_GATE_IMX8PV2_CORE_IMAGE_EXTRA_INSTALL} "

MACHINE_FIRMWARE:append = " firmware-nxp-wifi-nxpiw612-sdio "

COMPULAB_BOOTLOADER_MACHINES = "${MACHINE}"

CORE_IMAGE_EXTRA_INSTALL:append = " compulab-bootloader "
```

## conf/machine/iotdin-imx8p.conf
```bitbake
#@TYPE: Machine
#@NAME: CompuLab IOTDIN-IMX8PLUS - Industrial IoT Gateway
#@SOC: i.MX8MM
#@DESCRIPTION: Machine configuration for IOTDIN-IMX8PLUS
#@MAINTAINER: compulab@compulab.co.il

require compulab-imx8mp.inc

KERNEL_DEVICETREE = "${COMPULAB_IOTDIN_IMX8P_DEVICETREES}"

# Set u-boot DTB
UBOOT_DTB_NAME = "iotdin-imx8p.dtb"

IMAGE_INSTALL:append = " ${COMPULAB_IOTDIN_IMX8P_IMAGE_INSTALL} "

CORE_IMAGE_EXTRA_INSTALL += " ${COMPULAB_IOTDIN_IMX8P_CORE_IMAGE_EXTRA_INSTALL} "
```
