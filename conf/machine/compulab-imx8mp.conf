## conf/machine/mcm-imx8m-plus.conf
```bitbake
#@TYPE: Machine
#@NAME: CompuLab mcm-imx8m-plus Evaluation Kit
#@SOC: i.MX8MP
#@DESCRIPTION: Machine configuration for CompuLab mcm-imx8m-plus EVK
#@MAINTAINER: compulab@compulab.co.il

require compulab-imx8mp.inc

MACHINE_FEATURES:append:use-nxp-bsp = " ${COMPULAB_MCM_IMX8M_PLUS_MACHINE_FEATURES} "

KERNEL_DEVICETREE = "${COMPULAB_MCM_IMX8M_PLUS_DEVICETREES}"

# Set u-boot DTB
UBOOT_DTB_NAME = "mcm-imx8m-plus.dtb"

MACHINE_FIRMWARE:append = " ${COMPULAB_MCM_IMX8M_PLUS_MACHINE_FIRMWARE} "
```

## conf/machine/som-imx8m-plus.conf
```bitbake
#@TYPE: Machine
#@NAME: CompuLab som-imx8m-plus Evaluation Kit
#@SOC: i.MX8MM
#@DESCRIPTION: Machine configuration for CompuLab som-imx8m-plus EVK
#@MAINTAINER: compulab@compulab.co.il

require compulab-imx8mp.inc

MACHINE_FEATURES:append:use-nxp-bsp = " ${COMPULAB_SOM_IMX8M_PLUS_MACHINE_FEATURES} "

KERNEL_DEVICETREE = "${COMPULAB_SOM_IMX8M_PLUS_DEVICETREES}"

# Set u-boot DTB
UBOOT_DTB_NAME = "som-imx8m-plus.dtb"

CORE_IMAGE_EXTRA_INSTALL += " ${COMPULAB_SOM_IMX8M_PLUS_CORE_IMAGE_EXTRA_INSTALL} "
```
